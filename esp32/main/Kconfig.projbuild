## esp32/main/Kconfig.projbuild
```kconfig
menu "Hal9k ESP32Cam configuration"

     config HAL32CAM_ACCESS_KEY
            string "S3 access key"
            
     config HAL32CAM_SECRET_KEY
            string "S3 secret key"

     config HAL32CAM_INSTANCE
            int "Camera instance"
            default 0

endmenu
```
